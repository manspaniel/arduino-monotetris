#include "logos.h"
#include "splash.h"
#include "tetris.h"

const unsigned char ericsFace [] PROGMEM = {
	// 'splash-intro'
	0x00, 0x00, 0x11, 0x10, 0x00, 0x00, 0x00, 0x00, 0x00, 0x00, 0x00, 0x00, 0x00, 0x04, 0x55, 0x55, 
	0x40, 0x00, 0x00, 0x00, 0x08, 0x88, 0x00, 0x00, 0x00, 0x15, 0x55, 0x55, 0x50, 0x00, 0x00, 0x02, 
	0x2a, 0xa2, 0x20, 0x00, 0x00, 0x55, 0x75, 0x55, 0x54, 0x00, 0x00, 0xaa, 0xaa, 0xaa, 0xa8, 0x00, 
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	0x00, 0x00, 0x05, 0x50, 0x00, 0x00
};

const unsigned char edLogo [] PROGMEM = {
	// 'ed-logo'
	0xff, 0xcf, 0xfc, 0x00, 0xff, 0xcf, 0xfe, 0x00, 0xff, 0xcf, 0xff, 0x00, 0xe0, 0x0e, 0x0f, 0x80, 
	0xe0, 0x0e, 0x07, 0x80, 0xe0, 0x0e, 0x03, 0xc0, 0xff, 0xce, 0x03, 0xc0, 0xff, 0xce, 0x03, 0xc0, 
	0xff, 0xce, 0x03, 0xc0, 0xe0, 0x0e, 0x03, 0xc0, 0xe0, 0x0e, 0x07, 0x80, 0xe0, 0x0e, 0x0f, 0x80, 
	0xff, 0xcf, 0xff, 0x38, 0xff, 0xcf, 0xfe, 0x38, 0xff, 0xcf, 0xfc, 0x38, 0x00, 0x00, 0x00, 0x00, 
};

void LogosScene::init() {
  millisTillNextStage = millis() + millisPerStage;
	// lastMillis = millis();
	needsRedraw = true;
	nextScene = new TetrisScene();
}

void LogosScene::tick() {
	// nextScene = new MenuScene();
	if(millis() > millisTillNextStage) {
		millisTillNextStage = millis() + millisPerStage;
		needsRedraw = true;
		stage++;
	}
	if(stage >= 4) {
		nextScene = new SplashScene();
	}
}

void LogosScene::render(Display * display) {
	if(!needsRedraw) return;
	needsRedraw = false;
	display->setTextColor(BLACK);
	if(stage == 0) {
		display->fillScreen(BLACK);
	  display->drawBitmap(24, 13, ericsFace, 48, 65, WHITE);
	} else if(stage == 1) {
		// ED.
		display->fillScreen(WHITE);
	  display->drawBitmap(34, 39, edLogo, 32, 16, BLACK);
	} else if(stage == 2) {
		// ED. Presents...
		display->fillScreen(WHITE);
	  display->drawBitmap(34, 39, edLogo, 32, 16, BLACK);
		display->setCursor(25,60);
	  display->println("Presents");
		millisTillNextStage = millis() + millisPerStage * 1.5;
	}
	display->refresh();
}